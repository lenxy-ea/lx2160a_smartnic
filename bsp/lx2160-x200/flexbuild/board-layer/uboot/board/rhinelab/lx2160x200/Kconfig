## bsp/lx2160-x200/flexbuild/board-layer/uboot/board/rhinelab/lx2160x200/Kconfig
```kconfig
if TARGET_LX2160X200

config SYS_BOARD
	default "lx2160x200"

config SYS_VENDOR
	default "rhinelab"

config SYS_SOC
	default "fsl-layerscape"

config SYS_CONFIG_NAME
	default "lx2160x200"

endif
```

## bsp/lx2160-x200/flexbuild/board-layer/uboot/configs/lx2160x200_tfa_defconfig
```kconfig
CONFIG_ARM=y
CONFIG_SKIP_LOWLEVEL_INIT=y
CONFIG_GIC_V3_ITS=y
CONFIG_TARGET_LX2160X200=y
CONFIG_TFABOOT=y
CONFIG_TEXT_BASE=0x82000000
CONFIG_SYS_MALLOC_LEN=0x202000
CONFIG_SYS_MALLOC_F_LEN=0x6000
CONFIG_NR_DRAM_BANKS=3
CONFIG_ENV_SIZE=0x10000
CONFIG_ENV_OFFSET=0x500000
CONFIG_ENV_OFFSET_REDUND=0x510000
CONFIG_ENV_SECT_SIZE=0x10000
CONFIG_DEFAULT_DEVICE_TREE="fsl-lx2160a-x200"
CONFIG_SYS_MONITOR_LEN=958464
CONFIG_ARMV8_SEC_FIRMWARE_SUPPORT=y
CONFIG_SEC_FIRMWARE_ARMV8_PSCI=y
CONFIG_ENV_ADDR=0x20500000
CONFIG_DM_GPIO=y
CONFIG_FSL_CAAM=y
CONFIG_DM_RNG=y
CONFIG_FSL_CAAM_RNG=y
CONFIG_SYS_FSL_NUM_CC_PLLS=5
CONFIG_REMAKE_ELF=y
CONFIG_MP=y
CONFIG_EFI_LOADER_BOUNCE_BUFFER=y
CONFIG_FIT_VERBOSE=y
CONFIG_SHA256=y
CONFIG_BOOTDELAY=3
CONFIG_USE_BOOTCOMMAND=y
CONFIG_BOOTCOMMAND="run x200_boot"
CONFIG_OF_BOARD_SETUP=y
CONFIG_OF_STDOUT_VIA_ALIAS=y
CONFIG_SYS_PBSIZE=532
# CONFIG_ID_EEPROM is not set
CONFIG_CMD_GREPENV=y
CONFIG_CMD_NVEDIT_INFO=y
CONFIG_CMD_SAVEENV=y
CONFIG_CMD_EEPROM=y
CONFIG_SYS_EEPROM_PAGE_WRITE_BITS=7
CONFIG_SYS_EEPROM_PAGE_WRITE_DELAY_MS=5
CONFIG_CMD_DM=y
CONFIG_CMD_I2C=y
CONFIG_CMD_CACHE=y
CONFIG_OF_CONTROL=y
CONFIG_ENV_OVERWRITE=y
CONFIG_ENV_IS_IN_SPI_FLASH=y
CONFIG_SYS_REDUNDAND_ENVIRONMENT=y
CONFIG_ENV_SPI_BUS=0
CONFIG_ENV_SPI_CS=0
CONFIG_ENV_SPI_MAX_HZ=50000000
# CONFIG_NET_RANDOM_ETHADDR is not set
CONFIG_PCI=y
CONFIG_PCI_INIT_R=y
CONFIG_PCIE_LAYERSCAPE_RC=y
CONFIG_PCIE_LAYERSCAPE_EP=y
# CONFIG_PCIE_LAYERSCAPE_GEN4 is not set
CONFIG_AHCI=y
CONFIG_SATA=y
CONFIG_SATA_CEVA=y
CONFIG_DIMM_SLOTS_PER_CTLR=1
CONFIG_DDR_ECC=y
CONFIG_ECC_INIT_VIA_DDRCONTROLLER=y
CONFIG_SYS_FSL_DDR_INTLV_256B=y
CONFIG_MPC8XXX_GPIO=y
CONFIG_DM_I2C=y
CONFIG_I2C_SET_DEFAULT_BUS_NUM=y
CONFIG_SYS_I2C_EEPROM_ADDR=0x51
CONFIG_MTD=y
CONFIG_DM_SPI_FLASH=y
CONFIG_SPI_FLASH_WINBOND=y
# CONFIG_SPI_FLASH_USE_4K_SECTORS is not set
CONFIG_PHYLIB=y
CONFIG_FSL_MEMAC=y
CONFIG_SYS_MEMAC_LITTLE_ENDIAN=y
CONFIG_DM_RTC=y
CONFIG_RTC_DS1307=y
CONFIG_DM_SERIAL=y
CONFIG_PL01X_SERIAL=y
CONFIG_DEBUG_UART=y
CONFIG_DEBUG_UART_PL011=y
CONFIG_DEBUG_UART_BASE=0x21c0000
CONFIG_DEBUG_UART_CLOCK=150000000
CONFIG_DEBUG_UART_SKIP_INIT=y
CONFIG_STACKPROTECTOR=y
CONFIG_SPI=y
CONFIG_DM_SPI=y
CONFIG_FSL_DSPI=y
CONFIG_NXP_FSPI=y
CONFIG_WDT=y
CONFIG_WDT_SBSA=y
# Keep the watchdog disarmed during the development Linux handoff. Linux owns
# any later watchdog policy after userspace supervision is target-validated.
# CONFIG_WATCHDOG_AUTOSTART is not set
```
